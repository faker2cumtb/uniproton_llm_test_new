## src/arch/cpu/armv7-r/Kconfig
```kconfig
menu "ARM7-M Sepecfic Configuration"

depends on OS_ARCH_ARMV7_R

config INTERNAL_OS_D9340_SECURE
	bool
	select INTERNAL_OS_BYTE_ORDER_LE

choice
	prompt "Cpu Type"

config INTERNAL_OS_PLATFORM_D9340_SECURE
	bool "CORTEX_R5"
	select INTERNAL_OS_D9340_SECURE

endchoice

source arch/cpu/armv7-r/cortex-r5/Kconfig

endmenu
```

## testsuites/drivers-test/testcase.yaml
```yaml
common:
  testsuite_name: DRIVER_APP 
  tags: drivers

tests:
  drivers.gpio-test:
    min_flash: 64
  drivers.timer-test:
    min_flash: 64
  drivers.i2c-test:
    min_flash: 64
  drivers.smp-test:
    min_flash: 64
  drivers.localbus-test:
    min_flash: 64
```

## testsuites/fs-test/testcase.yaml
```yaml
common:
  testsuite_name: FS_APP 
  tags: fs

tests:
  fs.fs-test:
    min_flash: 64
    
```

## testsuites/hook-test/testcase.yaml
```yaml
common:
  testsuite_name: HOOK_APP 
  tags: hook

tests:
  hook.hook-test:
    min_flash: 64
```

## testsuites/kern-test/testcase.yaml
```yaml
common:
  testsuite_name: KERNEL_APP 
  tags: KERNEL
  min_ram: 32

tests:
  kernel.UniProton_test_sem:
    min_flash: 64
  kernel.UniProton_test_rr_sched:
    min_flash: 64
  kernel.UniProton_test_priority:
    min_flash: 64
  kernel.UniProton_test_mmu:
    min_flash: 64
  kernel.UniProton_test_ir:
    min_flash: 64
  kernel.UniProton_test_spinlock:
    min_flash: 64
```
