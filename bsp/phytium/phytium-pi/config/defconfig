## testsuites/libc-test/testcase.yaml
```yaml
common:
  testsuite_name: LIBC_POSIX_APP 
  tags: posix

tests:
  posixtestsuite.UniProton_test_posix_stdlib_interface:
    min_flash: 64
  posixtestsuite.UniProton_test_posix_ipc_interface:
    min_flash: 64
  posixtestsuite.UniProton_test_posix_string_interface:
    min_flash: 64
  posixtestsuite.UniProton_test_posix_regex_interface:
    min_flash: 64
  posixtestsuite.UniProton_test_posix_prng_interface:
    min_flash: 64
```

## testsuites/net-test/testcase.yaml
```yaml
common:
  testsuite_name: NET_APP 
  tags: net

tests:
  net.net-test:
    min_flash: 64
```

## testsuites/performance-test/testcase.yaml
```yaml
common:
  testsuite_name: PERFORMANCE_APP 
  tags: performancetest

tests:
  performance.stress_hrtimer_test:
    min_flash: 64
  performance.nostress_hrtimer_test:
    min_flash: 64
  performance.release_mutex_time_test:
    min_flash: 64
  performance.task_switch_stress:
    min_flash: 64
```

## testsuites/posixtestsuite/conformance/testcase.yaml
```yaml
common:
  testsuite_name: EXIT_APP 
  tags: exitapp
  min_ram: 32

tests:
  exit.UniProton_test_posix_exit__Exit_1_1:
    min_flash: 64
  exit.UniProton_test_posix_exit__Exit_1_2:
    min_flash: 64
  exit.UniProton_test_posix_exit_abort_1_1:
    min_flash: 64
  exit.UniProton_test_posix_exit_abort_1_2:
    min_flash: 64
  exit.UniProton_test_posix_exit_at_quick_exit_1_1:
    min_flash: 64
  exit.UniProton_test_posix_exit_at_quick_exit_1_2:
    min_flash: 64
  exit.UniProton_test_posix_exit_at_quick_exit_1_3:
    min_flash: 64
  exit.UniProton_test_posix_exit_atexit_1_1:
    min_flash: 64
  exit.UniProton_test_posix_exit_atexit_1_2:
    min_flash: 64
  exit.UniProton_test_posix_exit_atexit_1_3:
    min_flash: 64
  exit.UniProton_test_posix_exit_exit_1_1:
    min_flash: 64
  exit.UniProton_test_posix_exit_exit_1_2:
    min_flash: 64
  exit.UniProton_test_posix_exit_quick_exit_1_1:
    min_flash: 64
  exit.UniProton_test_posix_exit_quick_exit_1_2:
    min_flash: 64
```

## testsuites/posixtestsuite/testcase.yaml
```yaml
common:
  testsuite_name: POSIX_APP 
  tags: posix
  min_ram: 32

tests:
  posixtestsuite.UniProton_test_posix_time_interface:
    min_flash: 64
  posixtestsuite.UniProton_test_posix_thread_sem_interface:
    min_flash: 64
  posixtestsuite.UniProton_test_posix_thread_pthread_interface:
    min_flash: 64
  posixtestsuite.UniProton_test_posix_malloc_interface:
    min_flash: 64
  posixtestsuite.UniProton_test_posix_signal_interface:
    min_flash: 64
  posixtestsuite.UniProton_test_posix_rwflag_interface:
    min_flash: 64
```

## testsuites/rhealstone/testcase.yaml
```yaml
common:
  testsuite_name: RHEALSTONE_APP 
  tags: rhealstone

tests:
  rhealstone.deadlock-break:
    min_flash: 64
  rhealstone.interrupt-latency:
    min_flash: 64
  rhealstone.message-latency:
    min_flash: 64
  rhealstone.semaphore-shuffle:
    min_flash: 64
  rhealstone.task-preempt:
    min_flash: 64
  rhealstone.task-switch:
    min_flash: 64
    
```
